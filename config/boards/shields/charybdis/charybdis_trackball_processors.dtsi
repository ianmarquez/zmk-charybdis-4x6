#include "charybdis_layers.h"
#include <dt-bindings/zmk/input_transform.h>
#include <input/processors.dtsi>

#define CHARYBDIS_TRACKBALL_PROCESSORS \
    scroll { \
        layers = <SCROLL>; \
        input-processors = <&zip_xy_transform (INPUT_TRANSFORM_Y_INVERT)>, <&zip_xy_scaler 1 40>, <&zip_xy_to_scroll_mapper>; \
    }; \
    \
    move { \
        layers = <BASE POINTER>; \
        input-processors = <&zip_xy_scaler 3 2>; \
    };
